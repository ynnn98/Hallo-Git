## 嵌入侧-hi3863/19-voice/Kconfig
```kconfig
config UART_RX
    int
    prompt "set the B2."
    default 7
    depends on ENABLE_VOICE

config UART_TX
    int
    prompt "set the B3."
    default 8
    depends on ENABLE_VOICE
```

## 嵌入侧-hi3863/21_huaweiiot/Kconfig
```kconfig
config LDR_ADC_CHANNEL
    int
    prompt "set the ldr adc channel."
    default 5
    depends on ENABLE_HUAWEIIOT
```
